## boards/shields/silakka65/Kconfig.shield
```kconfig
config SHIELD_SILAKKA65_LEFT
    def_bool $(shields_list_contains,silakka65_left)
  
config SHIELD_SILAKKA65_RIGHT
    def_bool $(shields_list_contains,silakka65_right)
  
```
